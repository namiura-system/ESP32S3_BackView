## sdkconfig.defaults
```kconfig
# 既定値から変える設定だけを書く（Freenove ESP32-S3 WROOM CAM）
CONFIG_IDF_TARGET="esp32s3"

# Flash 8MB（DIO）、アプリ領域は大きいもの
CONFIG_ESPTOOLPY_FLASHMODE_DIO=y
CONFIG_ESPTOOLPY_FLASHSIZE_8MB=y
CONFIG_PARTITION_TABLE_SINGLE_APP_LARGE=y

# PSRAM（Octal、40MHz）。カメラのフレームバッファを置く
CONFIG_SPIRAM=y
CONFIG_SPIRAM_MODE_OCT=y
CONFIG_SPIRAM_SPEED_40M=y

# CPU 160MHz
CONFIG_ESP_DEFAULT_CPU_FREQ_MHZ_160=y
```
